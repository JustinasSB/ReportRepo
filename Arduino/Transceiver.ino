#define DATA_PIN 19
#define CS_PIN 21
#define signalPin 22
//Remote sends 986 signals
const int numDelays = 986;
//typical remote signal
unsigned long delays[numDelays] = {1022242, 1435, 4181, 720, 367, 367, 720, 367, 720, 720, 367, 367, 720,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 38806, 10644};

volatile unsigned long lastTime = 0;
volatile unsigned long lastPrint = 0;
volatile unsigned long lastPulse = 0;
volatile unsigned long pulseDuration = 0;
volatile unsigned int printedlines = 0;
const int maxPulses = 1000;
volatile unsigned long pulseDurations[maxPulses];
volatile int pulseCount = 0;
volatile bool newData = false;
const unsigned long TIMEOUT = 1000;

void IRAM_ATTR handleInterrupt(){
  unsigned long currentTime = micros();
  pulseDuration = currentTime - lastTime;
  lastTime = currentTime;
  if(pulseCount < maxPulses){
    pulseDurations[pulseCount++] = pulseDuration;
    lastPulse = currentTime;
  }
  if(pulseCount == maxPulses){
    newData = true;
  }
}

void rf_receiver_task( void * pvParameters ){
  attachInterrupt(digitalPinToInterrupt(DATA_PIN), handleInterrupt, CHANGE);
  delay(1000);
  while(1){
    unsigned long currentTime = micros();
    unsigned long currentMillis = millis();
    
    if(newData){
      Serial.println("Pulse durations");
      Serial.print("[");
      for(int i=0;i<pulseCount;i++){
        Serial.print(pulseDurations[i]);
        Serial.print(" ");
      }
      Serial.println("]");
      Serial.println("");
      pulseCount=0;
      newData=false;
    }
    if((currentMillis - (lastPulse)/1000 > TIMEOUT) && !newData){
      if(pulseCount<10) {
        pulseCount = 0;
        newData = false;
        lastPulse = micros();
      }
      else{
        Serial.println("timed out");
        Serial.print("[");
        for(int i=0;i<pulseCount;i++){
          Serial.print(pulseDurations[i]);
          Serial.print(" ");
        }
        Serial.println("]");
        Serial.println("");
        pulseCount = 0;
        newData = false;
        lastPulse = micros();
      }
    }
    delay(1000);
  }
}

void setup() {
    pinMode(signalPin, OUTPUT);
    pinMode(2, OUTPUT);
    Serial.begin(115200);
    delay(1000);
    pinMode(CS_PIN, OUTPUT);
    digitalWrite(CS_PIN,HIGH);
    Serial.println("decode test");
    pinMode(DATA_PIN, INPUT);
    xTaskCreatePinnedToCore(rf_receiver_task,"RF_Receiver_Task",4096,NULL,1,NULL,1);
}

void loop() {
    bool state = 0;
    for (int i = 0; i < numDelays; i++){
      digitalWrite(signalPin, state);
      state = !state;
      delayMicroseconds(delays[i]);
    }
  delay(30000)
}
